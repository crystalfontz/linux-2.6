## drivers/staging/rt2870/Kconfig
```kconfig
config RT2870
	tristate "Ralink 2870 wireless support"
	depends on USB && WLAN_80211
	---help---
	  This is an experimental driver for the Ralink 2870 wireless chip.
```
